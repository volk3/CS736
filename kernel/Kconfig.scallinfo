## kernel/Kconfig.scallinfo
```kconfig
config SCALLINFO
	bool "information about system calls"
	default y
	help
		A lightweight framework for information about syscalls
```

## kernel/Kconfig.syscnt
```kconfig
config SYSCNT
	bool "information about system calls"
	default y
	help
		A lightweight framework for information counting syscall usage per process
```
